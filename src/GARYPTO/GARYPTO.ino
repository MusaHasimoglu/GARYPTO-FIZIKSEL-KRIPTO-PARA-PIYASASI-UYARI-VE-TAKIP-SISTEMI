#include <TFT_eSPI.h>
#include <SPI.h>
#include <WiFi.h>
#include <HTTPClient.h>
#include <ArduinoJson.h>
#include <ESP32Servo.h> 

TFT_eSPI tft = TFT_eSPI();

// ================= AYARLAR =================
uint16_t calData[5] = {234, 3643, 246, 3542, 7}; 
const char* ssid = "WirchWirch"; 
const char* password = "1234567853"; 

#define BUZZER_PIN 17
#define SERVO_YESIL_PIN 4  
#define SERVO_KIRMIZI_PIN 5 

Servo servoYesil;
Servo servoKirmizi;

int aktifSayfa = 0; 
String seciliCoin = "";
String apiSymbol = "";
float anlikFiyat = 0.0;
unsigned long sonGuncelleme = 0;

// === 5 SANİYELİK ANİ DEĞİŞİM DEĞİŞKENLERİ ===
float oncekiFiyat = 0.0; 
float degisimSiniri = 50.0; 

// Alarm Değişkenleri
float hedefFiyat = 0.0; 
String hedefFiyatStr = ""; 
bool alarmKurulduMu = false;
bool alarmTetiklendiMi = false;
int alarmYonu = 0; 

// Numpad Ortak Değişkenleri
String girilenRakamStr = "";
int numpadModu = 1; 

// ================= LOGO VERİLERİ (RGB565) =================
const unsigned short btc_logo[1024] PROGMEM={
0xF483, 0xF483, 0xF483, 0xF483, 0xF483, 0xF483, 0xF483, 0xF483, 0xF483, 0xF483, 0xF483, 0xF483, 0xF483, 0xF483, 0xF483, 0xF483,
0xF483, 0xF483, 0xF483, 0xF483, 0xF483, 0xF483, 0xF483, 0xF483, 0xF483, 0xF483, 0xF483, 0xF483, 0xF483, 0xF483, 0xF483, 0xF483,
0xF483, 0xF483, 0xF483, 0xF483, 0xF483, 0xF483, 0xF483, 0xF483, 0xF483, 0xF483, 0xF483, 0xF483, 0xF483, 0xF483, 0xF483, 0xF483,
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0xF483, 0xF483, 0xF483, 0xF483, 0xF483, 0xF483, 0xF483, 0xF483, 0xF483, 0xF483, 0xF483, 0xF483, 0xF483, 0xF483, 0xF483, 0xF483
};

const unsigned short eth_logo[1024] PROGMEM={
0x63FD, 0x63FD, 0x63FD, 0x63FD, 0x63FD, 0x63FD, 0x63FD, 0x63FD, 0x63FD, 0x63FD, 0x63FD, 0x63FD, 0x63FD, 0x63FD, 0x63FD, 0x63FD,
0x63FD, 0x63FD, 0x63FD, 0x63FD, 0x63FD, 0x63FD, 0x63FD, 0x63FD, 0x63FD, 0x63FD, 0x63FD, 0x63FD, 0x63FD, 0x63FD, 0x63FD, 0x63FD,
0x63FD, 0x63FD, 0x63FD, 0x63FD, 0x63FD, 0x63FD, 0x63FD, 0x63FD, 0x63FD, 0x63FD, 0x63FD, 0x63FD, 0x63FD, 0x63FD, 0x63FD, 0x63FD,
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0x63FD, 0x63FD, 0x63FD, 0x63FD, 0x63FD, 0x63FD, 0x63FD, 0x63FD, 0x63FD, 0x63FD, 0x63FD, 0x63FD, 0x63FD, 0x63FD, 0x63FD, 0x63FD
};

const unsigned short bnb_logo[1024] PROGMEM={
0xF5C1, 0xF5C1, 0xF5C1, 0xF5C1, 0xF5C1, 0xF5C1, 0xF5C1, 0xF5C1, 0xF5C1, 0xF5C1, 0xF5C1, 0xF5C1, 0xF5C1, 0xF5C1, 0xF5C1, 0xF5C1,
0xF5C1, 0xF5C1, 0xF5C1, 0xF5C1, 0xF5C1, 0xF5C1, 0xF5C1, 0xF5C1, 0xF5C1, 0xF5C1, 0xF5C1, 0xF5C1, 0xF5C1, 0xF5C1, 0xF5C1, 0xF5C1,
0xF5C1, 0xF5C1, 0xF5C1, 0xF5C1, 0xF5C1, 0xF5C1, 0xF5C1, 0xF5C1, 0xF5C1, 0xF5C1, 0xF5C1, 0xF5C1, 0xF5C1, 0xF5C1, 0xF5C1, 0xF5C1,
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0xF5C1, 0xF5E4, 0xF5E4, 0xF5E2, 0xF5E2, 0xF5C1, 0xF5C1, 0xF5C1, 0xF5C1, 0xF5C1, 0xF5C1, 0xF5C1, 0xF5C1, 0xF5C1, 0xF5C1, 0xF5C1
};

// =========================================================================

void setup() {
  Serial.begin(115200);
  pinMode(BUZZER_PIN, OUTPUT);
  tft.init();
  tft.setRotation(1); 
  tft.setTouch(calData); 

  // Servo Kurulumu 
  ESP32PWM::allocateTimer(0);
  ESP32PWM::allocateTimer(1);
  servoYesil.setPeriodHertz(50);
  servoKirmizi.setPeriodHertz(50);
  
  // Yeşil motor ters yönde çalışması için 90'da başlatılıyor
  servoYesil.attach(SERVO_YESIL_PIN, 500, 2400);
  servoYesil.write(90); 
  delay(300); 
  
  servoKirmizi.attach(SERVO_KIRMIZI_PIN, 500, 2400);
  servoKirmizi.write(0); 
  delay(300); 
  
  tft.fillScreen(TFT_BLACK);
  tft.setTextColor(TFT_ORANGE); tft.setTextSize(3); tft.setTextDatum(MC_DATUM);
  tft.drawString("GARYPTO", tft.width()/2, tft.height()/2 - 30);
  tft.setTextColor(TFT_WHITE); tft.setTextSize(2);
  tft.drawString("Wi-Fi Baglaniyor...", tft.width()/2, tft.height()/2 + 20);

  WiFi.begin(ssid, password);
  while (WiFi.status() != WL_CONNECTED) { delay(500); }
  
  tft.fillScreen(TFT_BLACK);
  tft.setTextColor(TFT_GREEN);
  tft.drawString("INTERNETE BAGLANDI!", tft.width()/2, tft.height()/2);
  kisaBip(); delay(1000);
  
  anaMenuyuCiz();
}

void loop() {
  uint16_t x, y;

  if (aktifSayfa == 1) {
    if (millis() - sonGuncelleme > 5000) {
      fiyatCekVeYazdir();
      sonGuncelleme = millis();
    }
    // GÜNCELLEME 1: Alarm tetiklendiğinde artık servo motorlar çağrılmıyor
    if (alarmKurulduMu && !alarmTetiklendiMi && anlikFiyat > 0) {
      if (alarmYonu == 1 && anlikFiyat >= hedefFiyat) { 
        alarmTetikle();
      } 
      if (alarmYonu == -1 && anlikFiyat <= hedefFiyat) { 
        alarmTetikle();
      } 
    }
  }

  if (tft.getTouch(&x, &y)) {
    if (aktifSayfa == 0) {
      if (x > 20 && x < 240 && y > 70 && y < 180) { kisaBip(); seciliCoin = "BTC"; apiSymbol = "BTCUSDT"; canliEkranaGec(); }
      else if (x > 240 && x < 460 && y > 70 && y < 180) { kisaBip(); seciliCoin = "ETH"; apiSymbol = "ETHUSDT"; canliEkranaGec(); }
      else if (x > 130 && x < 350 && y > 190 && y < 300) { kisaBip(); seciliCoin = "BNB"; apiSymbol = "BNBUSDT"; canliEkranaGec(); }
    }
    else if (aktifSayfa == 1) {
      if (x > 330 && x < 460 && y > 240 && y < 300) { kisaBip(); numpadModu = 1; numpadEkraninaGec(); } 
      else if (x > 170 && x < 310 && y > 240 && y < 300) { kisaBip(); numpadModu = 2; numpadEkraninaGec(); } 
      else if (x > 20 && x < 150 && y > 240 && y < 300) { kisaBip(); anaMenuyuCiz(); } 
    }
    else if (aktifSayfa == 2) {
      numpadDokunmatikKontrol(x, y);
    }
    delay(200); 
  }
}

// ================= API VE MEKANİK FONKSİYONLAR =================
void fiyatCekVeYazdir() {
  if (WiFi.status() == WL_CONNECTED) {
    HTTPClient http;
    http.begin("https://api.binance.com/api/v3/ticker/price?symbol=" + apiSymbol);
    if (http.GET() > 0) {
      String payload = http.getString();
      JsonDocument doc;
      deserializeJson(doc, payload);
      float yeniFiyat = doc["price"].as<float>();

      if (oncekiFiyat == 0.0) { 
        oncekiFiyat = yeniFiyat; 
      }

      // Merkez noktası (oncekiFiyat) ile anlık gelen fiyat arasındaki 5 saniyelik fark
      float fark = yeniFiyat - oncekiFiyat;

      // === 1. ADIM: ÖNCE YENİ FİYATI EKRANA YAZDIR ===
      anlikFiyat = yeniFiyat;
      tft.fillRect(10, 90, 460, 65, TFT_BLACK); 
      tft.setTextSize(5); tft.setTextColor(TFT_GREEN, TFT_BLACK); tft.setTextDatum(MC_DATUM);
      tft.drawString("$" + String(anlikFiyat, 3), tft.width()/2, 120); 

      // === 2. ADIM: SONRA BAYRAKLARI VE ALARMI TETİKLE ===
      // Motorlar sadece son 5 saniye içindeki fark limiti aşarsa kalkar
      if (fabs(fark) >= degisimSiniri) {
        if (fark > 0) {
          bayrakKaldir(1);  
        } else {
          bayrakKaldir(-1); 
        }
      }

      // === 3. ADIM: MERKEZ NOKTASINI HER 5 SANİYEDE BİR GÜNCELLE ===
      // Alarm çalsa da çalmasa da, bir sonraki 5 saniye için merkez noktamız artık bu yeni fiyattır.
      oncekiFiyat = yeniFiyat; 

    } else {
      tft.fillRect(10, 90, 460, 65, TFT_BLACK); 
      tft.setTextSize(3); tft.setTextColor(TFT_RED, TFT_BLACK); tft.setTextDatum(MC_DATUM);
      tft.drawString("BAGLANTI HATASI!", tft.width()/2, 120);
    }
    http.end();
  } 
}

void bayrakKaldir(int yon) {
  if (yon == 1) { 
    tft.fillRect(0, 0, tft.width(), 80, TFT_DARKGREEN);
    tft.setTextColor(TFT_WHITE); tft.setTextSize(3); tft.setTextDatum(MC_DATUM);
    tft.drawString("ANI YUKSELIS!", tft.width()/2, 40);
    
    // Yeşil bayrak 90'dan 0'a ters kalkar
    for (int pos = 90; pos >= 0; pos -= 2) { servoYesil.write(pos); delay(15); }
    for(int i=0; i<4; i++) { tone(BUZZER_PIN, 1500, 200); delay(200); tone(BUZZER_PIN, 1000, 200); delay(200); }
    for (int pos = 0; pos <= 90; pos += 2) { servoYesil.write(pos); delay(15); }

  } else if (yon == -1) { 
    tft.fillRect(0, 0, tft.width(), 80, TFT_RED);
    tft.setTextColor(TFT_WHITE); tft.setTextSize(3); tft.setTextDatum(MC_DATUM);
    tft.drawString("ANI DUSUS!", tft.width()/2, 40);
    
    // Kırmızı bayrak standart 0'dan 90'a kalkar
    for (int pos = 0; pos <= 90; pos += 2) { servoKirmizi.write(pos); delay(15); }
    for(int i=0; i<4; i++) { tone(BUZZER_PIN, 500, 200); delay(200); tone(BUZZER_PIN, 300, 200); delay(200); } 
    for (int pos = 90; pos >= 0; pos -= 2) { servoKirmizi.write(pos); delay(15); }
  }
  
  tft.fillRect(0, 0, tft.width(), 80, TFT_BLACK);
  tft.setTextColor(TFT_WHITE); tft.setTextSize(3);
  tft.drawString(seciliCoin + " CANLI TAKIP", tft.width()/2, 40);
}

void alarmTetikle() {
  alarmTetiklendiMi = true; alarmKurulduMu = false; 
  tft.fillRect(0, 0, tft.width(), 80, TFT_BLUE);
  tft.setTextColor(TFT_WHITE); tft.setTextSize(3); tft.setTextDatum(MC_DATUM);
  tft.drawString("HEDEF VURULDU!", tft.width()/2, 40);
  
  // GÜNCELLEME 1: Sadece buzzer ile ikaz veriyor
  for(int i=0; i<6; i++) {
    tone(BUZZER_PIN, 2000, 150); delay(150);
    tone(BUZZER_PIN, 2500, 150); delay(150);
  }
}

// ================= ARAYÜZ FONKSİYONLARI =================
void anaMenuyuCiz() {
  aktifSayfa = 0; alarmKurulduMu = false; alarmTetiklendiMi = false; hedefFiyat = 0.0; anlikFiyat = 0.0; hedefFiyatStr = "";
  oncekiFiyat = 0.0; 

  tft.fillScreen(TFT_BLACK);
  tft.setTextSize(3); tft.setTextColor(TFT_WHITE, TFT_BLACK); tft.setTextDatum(TC_DATUM); 
  tft.drawString("Kripto Secin", tft.width() / 2, 20);

  int btnH = 90; int iconOffset = (btnH - 32) / 2; 

  tft.setSwapBytes(true); 

  tft.fillRoundRect(30, 70, 200, btnH, 8, tft.color565(220, 90, 0)); 
  tft.pushImage(30 + 15, 70 + iconOffset, 32, 32, btc_logo); 
  tft.setTextColor(TFT_BLACK); tft.setTextDatum(MC_DATUM); tft.setTextSize(3);
  tft.drawString("BTC", 30 + 130, 70 + (btnH/2));

  tft.fillRoundRect(250, 70, 200, btnH, 8, TFT_PURPLE);
  tft.pushImage(250 + 15, 70 + iconOffset, 32, 32, eth_logo);
  tft.setTextColor(TFT_WHITE); 
  tft.drawString("ETH", 250 + 130, 70 + (btnH/2));

  tft.fillRoundRect(140, 190, 200, btnH, 8, TFT_GOLD);
  tft.pushImage(140 + 15, 190 + iconOffset, 32, 32, bnb_logo);
  tft.setTextColor(TFT_BLACK); 
  tft.drawString("BNB", 140 + 130, 190 + (btnH/2));

  tft.setSwapBytes(false); 
}

void canliEkranaGec() {
  aktifSayfa = 1; sonGuncelleme = 0; 
  tft.fillScreen(TFT_BLACK);
  tft.setTextSize(3); tft.setTextColor(TFT_WHITE); tft.setTextDatum(MC_DATUM);
  tft.drawString(seciliCoin + " CANLI TAKIP", tft.width()/2, 30);

  tft.setTextSize(2); tft.setTextColor(TFT_YELLOW);
  
  if (alarmKurulduMu) { tft.drawString("Hedef: $" + hedefFiyatStr, tft.width()/2, 175); } 
  else { tft.drawString("Hedef: Yok", tft.width()/2, 175); } 
  
  tft.drawString("Ani Limit: $" + String(degisimSiniri, 2), tft.width()/2, 205);

  tft.fillRoundRect(20, 240, 130, 60, 8, TFT_DARKGREY); 
  tft.setTextColor(TFT_WHITE); tft.drawString("GERI", 85, 270);
  
  tft.fillRoundRect(170, 240, 140, 60, 8, TFT_PURPLE); 
  tft.setTextColor(TFT_WHITE); tft.drawString("LIMIT", 240, 270);

  tft.fillRoundRect(330, 240, 130, 60, 8, TFT_BLUE); 
  tft.setTextColor(TFT_WHITE); tft.drawString("ALARM", 395, 270);
}

void numpadEkraninaGec() { aktifSayfa = 2; girilenRakamStr = ""; tft.fillScreen(TFT_BLACK); numpadArayuzunuCiz(); }

void numpadArayuzunuCiz() {
  tft.setTextSize(2); tft.setTextColor(TFT_LIGHTGREY); tft.setTextDatum(TC_DATUM);
  
  if (numpadModu == 1) { tft.drawString("Hedef Fiyati Girin:", tft.width()/2, 10); }
  else if (numpadModu == 2) { tft.drawString("Ani Degisim Limitini Girin:", tft.width()/2, 10); }
  
  numpadEkraniGuncelle();

  tft.setTextSize(3); tft.setTextDatum(MC_DATUM);
  int btnW = 70; int btnH = 50;
  tft.fillRoundRect(30, 80, btnW, btnH, 5, TFT_DARKGREY);  tft.setTextColor(TFT_WHITE); tft.drawString("1", 65, 105);
  tft.fillRoundRect(30, 140, btnW, btnH, 5, TFT_DARKGREY); tft.drawString("4", 65, 165);
  tft.fillRoundRect(30, 200, btnW, btnH, 5, TFT_DARKGREY); tft.drawString("7", 65, 225);
  tft.fillRoundRect(30, 260, btnW, btnH, 5, TFT_DARKGREY); tft.drawString(".", 65, 285);
  tft.fillRoundRect(110, 80, btnW, btnH, 5, TFT_DARKGREY);  tft.drawString("2", 145, 105);
  tft.fillRoundRect(110, 140, btnW, btnH, 5, TFT_DARKGREY); tft.drawString("5", 145, 165);
  tft.fillRoundRect(110, 200, btnW, btnH, 5, TFT_DARKGREY); tft.drawString("8", 145, 225);
  tft.fillRoundRect(110, 260, btnW, btnH, 5, TFT_DARKGREY); tft.drawString("0", 145, 285);
  tft.fillRoundRect(190, 80, btnW, btnH, 5, TFT_DARKGREY);  tft.drawString("3", 225, 105);
  tft.fillRoundRect(190, 140, btnW, btnH, 5, TFT_DARKGREY); tft.drawString("6", 225, 165);
  tft.fillRoundRect(190, 200, btnW, btnH, 5, TFT_DARKGREY); tft.drawString("9", 225, 225);
  tft.fillRoundRect(190, 260, btnW, btnH, 5, TFT_RED);      tft.drawString("C", 225, 285);
  
  // GÜNCELLEME 2: GERİ ve ONAY butonları ayrıldı
  tft.fillRoundRect(280, 80, 170, 70, 8, TFT_ORANGE); 
  tft.setTextColor(TFT_WHITE); tft.setTextSize(3); 
  tft.drawString("GERI", 365, 115);

  tft.fillRoundRect(280, 160, 170, 150, 8, TFT_GREEN); 
  tft.setTextColor(TFT_BLACK); tft.setTextSize(4); 
  tft.drawString("ONAY", 365, 235);
}

void numpadEkraniGuncelle() {
  tft.fillRect(0, 35, tft.width(), 40, TFT_BLACK); 
  tft.setTextSize(4); tft.setTextColor(TFT_YELLOW); tft.setTextDatum(MC_DATUM);
  tft.drawString("$" + girilenRakamStr, tft.width()/2, 55);
}

void numpadDokunmatikKontrol(uint16_t x, uint16_t y) {
  bool basildi = false;
  if (x > 30 && x < 100) {
    if (y > 80 && y < 130) { girilenRakamStr += "1"; basildi = true; }
    else if (y > 140 && y < 190) { girilenRakamStr += "4"; basildi = true; }
    else if (y > 200 && y < 250) { girilenRakamStr += "7"; basildi = true; }
    else if (y > 260 && y < 310) { girilenRakamStr += "."; basildi = true; }
  }
  else if (x > 110 && x < 180) {
    if (y > 80 && y < 130) { girilenRakamStr += "2"; basildi = true; }
    else if (y > 140 && y < 190) { girilenRakamStr += "5"; basildi = true; }
    else if (y > 200 && y < 250) { girilenRakamStr += "8"; basildi = true; }
    else if (y > 260 && y < 310) { girilenRakamStr += "0"; basildi = true; }
  }
  else if (x > 190 && x < 260) {
    if (y > 80 && y < 130) { girilenRakamStr += "3"; basildi = true; }
    else if (y > 140 && y < 190) { girilenRakamStr += "6"; basildi = true; }
    else if (y > 200 && y < 250) { girilenRakamStr += "9"; basildi = true; }
    else if (y > 260 && y < 310) { 
      if (girilenRakamStr.length() > 0) { girilenRakamStr.remove(girilenRakamStr.length() - 1); }
      basildi = true; 
    }
  }
  // GÜNCELLEME 2'NİN DEVAMI: GERİ VE ONAY KOORDİNAT KONTROLLERİ
  else if (x > 280 && x < 450) {
    if (y > 80 && y < 150) {
      kisaBip();
      canliEkranaGec(); // GERİ butonuna basıldı, değer kaydetmeden dön
      return;
    }
    else if (y > 160 && y < 310) {
      kisaBip();
      if (girilenRakamStr.length() > 0) {
        if (numpadModu == 1) { 
          hedefFiyat = girilenRakamStr.toFloat(); hedefFiyatStr = girilenRakamStr; alarmKurulduMu = true; alarmTetiklendiMi = false;
          if (hedefFiyat > anlikFiyat) { alarmYonu = 1; } else { alarmYonu = -1; } 
        } 
        else if (numpadModu == 2) { 
          degisimSiniri = girilenRakamStr.toFloat(); 
        }
        onaySesiCal(); canliEkranaGec(); 
      }
      return;
    }
  }
  
  if (basildi) {
    kisaBip();
    if (girilenRakamStr.length() > 10) girilenRakamStr = girilenRakamStr.substring(0, 10);
    numpadEkraniGuncelle();
  }
}

void kisaBip() { tone(BUZZER_PIN, 2000, 50); }
void onaySesiCal() { tone(BUZZER_PIN, 1000, 100); delay(100); tone(BUZZER_PIN, 1500, 100); delay(100); tone(BUZZER_PIN, 2000, 200); }